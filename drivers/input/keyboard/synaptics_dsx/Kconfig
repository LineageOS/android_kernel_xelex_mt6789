## drivers/input/keyboard/synaptics_dsx/Kconfig
```kconfig
#
# Synaptics DSX KEYBOARD driver configuration
#
config KEYBOARD_SYNAPTICS_DSX
	tristate "Synaptics DSX KEYBOARD"
	default m
	help
	  Say Y here if you have a Synaptics DSX KEYBOARD connected
	  to your system.
	  If unsure, say N.

config KEYBOARD_SYNAPTICS_DSX_FW_UPDATE
	tristate "Synaptics DSX KEYBOARD firmware update module"
	depends on KEYBOARD_SYNAPTICS_DSX
	help
	  Say Y here to enable support for carrying out firmware update.

	  If unsure, say N.

	  To compile this driver as a module, choose M here: the
	  module will be called synaptics_dsx_fw_update.
```
